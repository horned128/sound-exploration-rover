## firmware/esp32s3/sdkconfig.defaults
```kconfig
CONFIG_ESPTOOLPY_FLASHSIZE_8MB=y
CONFIG_ESP_CONSOLE_NONE=y
CONFIG_BOOTLOADER_LOG_LEVEL_NONE=y
CONFIG_LOG_DEFAULT_LEVEL_NONE=y
CONFIG_TINYUSB_CDC_ENABLED=y
CONFIG_TINYUSB_CDC_COUNT=1
CONFIG_TINYUSB_CDC_RX_BUFSIZE=512
CONFIG_TINYUSB_CDC_TX_BUFSIZE=512
CONFIG_TINYUSB_CDC_EP_BUFSIZE=64
CONFIG_TINYUSB_MSC_ENABLED=n
CONFIG_TINYUSB_HID_COUNT=0
CONFIG_TINYUSB_MIDI_COUNT=0
CONFIG_TINYUSB_VENDOR_COUNT=0
CONFIG_TINYUSB_DFU_MODE_NONE=y
CONFIG_TINYUSB_NET_MODE_NONE=y
CONFIG_TINYUSB_DESC_MANUFACTURER_STRING="Sound Exploration Rover"
CONFIG_TINYUSB_DESC_PRODUCT_STRING="ReSpeaker Acoustic Frontend"
CONFIG_TINYUSB_DESC_CDC_STRING="Rover Acoustic Link"
CONFIG_FREERTOS_HZ=1000
```
